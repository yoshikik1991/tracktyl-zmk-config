## config/west.yml
```yaml
manifest:
  remotes:
    - name: zmk
      url-base: https://github.com/drorchen
  projects:
    - name: zmk
      remote: zmk
      revision: charybdis-with-trackball
      import: app/west.yml
  self:
    path: config
```
