#include "tracktyl.dtsi" // Notice that the main dtsi files are included in the overlay.

&default_transform {
    col-offset = <0>;
};

&kscan0 {
		row-gpios
			= <&gpio0  3 (GPIO_ACTIVE_HIGH | GPIO_PULL_DOWN)>
			, <&gpio0 28 (GPIO_ACTIVE_HIGH | GPIO_PULL_DOWN)>
			, <&gpio1 11 (GPIO_ACTIVE_HIGH | GPIO_PULL_DOWN)>
			, <&gpio0 10 (GPIO_ACTIVE_HIGH | GPIO_PULL_DOWN)>
			;
   	col-gpios
      = <&gpio1 13 GPIO_ACTIVE_HIGH>
		  , <&gpio0  2 GPIO_ACTIVE_HIGH>
		  , <&gpio0 29 GPIO_ACTIVE_HIGH>
		  , <&gpio0 31 GPIO_ACTIVE_HIGH>
		  , <&gpio0 30 GPIO_ACTIVE_HIGH>
		  ;
};
